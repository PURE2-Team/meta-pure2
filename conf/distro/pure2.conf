## conf/distro/pure2.conf
```bitbake
#@TYPE: Distribution
#@NAME: PURE2
#@DESCRIPTION: Embedded Linux Distribution Configuration for STB's

DISTRO_FEATURES_BACKFILL_CONSIDERED += "pulseaudio gobject-introspection-data"

OE_TERMINAL ?= "auto"
DISTRO_NAME ?= "pure2"
DISTRO_VERSION = "6.2"
DISTRO_TYPE ?= "release"
BUILD_VERSION = "002"
DEVELOPER_BUILD_VERSION = "000"
BB_HASH_IGNORE_MISMATCH = "1"
DEFAULT_TIMEZONE = "Europe/Berlin"

BUILDCFG_VARS += " ENIGMA2_URI PKGDATA_DIR MACHINEBUILD BUILD_VERSION DEPLOY_DIR_IPK DISTRO_FEED_URI ENIGMA2_PLUGINS_URI BBMASK TARGET_ARCH DISTRO_FEATURES"
# default Enigma2 skin.
E2DEFAULTSKIN ?= "enigma2-plugin-skins-estuary"

ENIGMA2_URI ?= "https://github.com/PURE2-Team/pure2.git"

ENIGMA2_PLUGINS_URI = "git://github.com/oe-alliance/enigma2-plugins.git;protocol=git;branch=master"

ENIGMA2_SKINS_URI ?= "git://github.com/OpenViX/enigma2-skins.git;protocol=git"

IPKG_VARIANT = "opkg"

FEED_NAME ?= "${DISTRO_NAME}-${DISTRO_VERSION}"
DISTRO_FEED_URI ?= "http://pur-e2.club/OU/6.2/${MACHINEBUILD}"
DISTRO_FEED_PREFIX ?= "pure2"

IMAGE_VERSION = "${DISTRO_VERSION}"

IMAGE_NAME = "${MACHINEBUILD}-PurE2-${DISTRO_VERSION}-${DATE}"
IMAGE_NAME[vardepsexclude] += "DATE"
IMAGE_ROOTFS = "${TMPDIR}/rootfs/${MACHINE}"
IMAGE_LINK_NAME = ""
CACHE ?= "${TMPDIR}/cache/${LIBC}/${MACHINE}"
DEPLOY_DIR ?= "${TMPDIR}/deploy/${LIBC}"
DEPLOY_DIR_IMAGE = "${DEPLOY_DIR}/images/${MACHINE}"

require conf/distro/include/unstable-versions.inc

VIRTUAL-RUNTIME_dev_manager = "busybox-mdev"
VIRTUAL-RUNTIME_login_manager = "busybox"
VIRTUAL-RUNTIME_init_manager = "sysvinit"
VIRTUAL-RUNTIME_initscripts = "initscripts"

PREFERRED_PROVIDERS += "virtual/${TARGET_PREFIX}gcc-initial:gcc-cross-initial"
PREFERRED_PROVIDERS += "virtual/${TARGET_PREFIX}gcc-intermediate:gcc-cross-intermediate"
PREFERRED_PROVIDERS += "virtual/${TARGET_PREFIX}gcc:gcc-cross"
PREFERRED_PROVIDERS += "virtual/${TARGET_PREFIX}g++:gcc-cross"

FULL_OPTIMIZATION = "-Os -pipe ${DEBUG_FLAGS}"

O3_OPT = "-O3 -pipe ${DEBUG_FLAGS}"
FULL_OPTIMIZATION_pn-flac = "${O3_OPT}"
FULL_OPTIMIZATION_pn-jpeg = "${O3_OPT}"
FULL_OPTIMIZATION_pn-lame = "${O3_OPT}"
FULL_OPTIMIZATION_pn-liba52 = "${O3_OPT}"
FULL_OPTIMIZATION_pn-libdca = "${O3_OPT}"
FULL_OPTIMIZATION_pn-libgcrypt = "${O3_OPT}"
FULL_OPTIMIZATION_pn-libmad = "${O3_OPT}"
FULL_OPTIMIZATION_pn-libogg = "${O3_OPT}"
FULL_OPTIMIZATION_pn-libpng = "${O3_OPT}"
FULL_OPTIMIZATION_pn-libsamplerate = "${O3_OPT}"
FULL_OPTIMIZATION_pn-libvorbis = "${O3_OPT}"
FULL_OPTIMIZATION_pn-tremor = "${O3_OPT}"
FULL_OPTIMIZATION_pn-zlib = "${O3_OPT}"

PYTHON_BASEVERSION ?= "2.7"
PREFERRED_VERSION_python ?= "2.7.13"
PREFERRED_VERSION_python-native ?= "2.7.13"

# Force the older version of liberation-fonts until we fix the fontforge issue
PREFERRED_VERSION_liberation-fonts ?= "1.04"

PREFERRED_VERSION_netatalk ?= "2.2.3"

DISTRO_FEATURES = "bluez5 directfb gtk-directfb pulseaudio alsa argp bluetooth ext2 irda largefile mplt pcmcia wifi wifi-extra xattr nfs appletalk smbfs zeroconf pci ${DISTRO_FEATURES_LIBC} pam  no-autobouquetsmaker tuxtxtfhd "

DISTRO_FEATURES_remove_spark7162 = " pam bluetooth appletalk " 
DISTRO_FEATURES_remove_spark = " pam bluetooth appletalk  " 
DISTRO_FEATURES_remove_dm500hd = " pam bluetooth appletalk " 
DISTRO_FEATURES_remove_dm800se = " pam bluetooth appletalk bluez5 " 
MACHINE_FEATURES_append_dm800se = " no-nmap "
MACHINE_FEATURES_append_dm500hd = " no-nmap "

QA_LOG = "1"
QA_LOGFILE = "${TMPDIR}/qa.log"

OEINCLUDELOGS ?= "yes"
KERNEL_CONSOLE ?= "ttyS0,115200n8"

BB_GENERATE_MIRROR_TARBALLS ??= "0"

NO32LIBS ??= "1"

# Missing checksums should raise an error
BB_STRICT_CHECKSUM = "0"

TCLIBCAPPEND = ""

# Drop unused PACKAGE_EXTRA_ARCHS
PACKAGE_EXTRA_ARCHS = "${TUNE_PKGARCH} ${OEM_ARCH}"

# add support for extra feeds
PACKAGE_ARCHS += " 3rdparty private"

# Gstreamer 1.x if not used libeplayer
GST_VERSION = "${@bb.utils.contains("MACHINE_FEATURES", "libeplayer", "" , "1.0", d)}"

LICENSE_FLAGS_WHITELIST = "commercial_gst-plugins-ugly commercial_lame commercial_libmad commercial_mpeg2dec commercial_ffmpeg commercial_libav commercial_x264 commercial_gstreamer1.0-libav commercial_gstreamer1.0-plugins-ugly commercial_mpg123 commercial_libomxil"
COMMERCIAL_AUDIO_PLUGINS ?= "gst-plugins-ugly-mad gst-plugins-ugly-mpegaudioparse gstreamer1.0-plugins-ugly-mad"
COMMERCIAL_VIDEO_PLUGINS ?= "gst-plugins-ugly-mpeg2dec gst-plugins-ugly-mpegstream gst-plugins-bad-mpegvideoparse gstreamer1.0-plugins-ugly-mpeg2dec"
```

## conf/layer.conf
```bitbake
# We have a conf and classes directory, append to BBPATH
BBPATH .= ":${LAYERDIR}"

# We have a recipes directory, add to BBFILES
BBFILES += "${LAYERDIR}/recipes-*/*.bb ${LAYERDIR}/recipes-*/*.bbappend"
BBFILES += "${LAYERDIR}/recipes-*/*/*.bb ${LAYERDIR}/recipes-*/*/*.bbappend"
BBFILES += "${LAYERDIR}/recipes-*/*/*/*.bb ${LAYERDIR}/recipes-*/*/*/*.bbappend"

BBFILE_COLLECTIONS += "pure2-layer"
BBFILE_PATTERN_pure2-layer := "^${LAYERDIR}/"
BBFILE_PRIORITY_pure2-layer = "90"


#BBMASK += "meta-oe-alliance/meta-oe/conf/distro"
```
